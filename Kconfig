## Kconfig
```kconfig
# Copyright (c) 2024 The ZMK Contributors
# SPDX-License-Identifier: MIT

# These options live at module level (not inside "if SHIELD_DONGLE_SCREEN")
# so that peripheral builds that pull in zmk-dongle-screen via west.yml can
# enable the relay GATT service without selecting the dongle_screen shield.

config DONGLE_SCREEN_BATTERY_RELAY
    bool "Relay battery levels and layer state between dongle and keyboard halves"
    depends on BT && ZMK_SPLIT
    help
      When enabled the central (dongle) discovers the battery relay GATT
      characteristic on each connected peripheral and writes every battery
      level change to it.  Each peripheral side hosts the GATT service,
      stores the received levels, and raises zmk_peripheral_battery_state_changed
      events so the battery_status display widget redraws automatically.
      Layer data is multiplexed through the same characteristic.
      Enable on both the central (dongle) and peripheral (keyboard half) builds.

config DONGLE_SCREEN_BATTERY_RELAY_SOURCE_COUNT
    int "Number of battery sources displayed in peripheral relay mode"
    default 2
    range 1 8
    depends on DONGLE_SCREEN_BATTERY_RELAY && !ZMK_SPLIT_ROLE_CENTRAL
    help
      How many battery source slots to allocate in peripheral relay mode.
      For a standard 2-split keyboard (left + right) use the default of 2.
      Increase if more splits exist.
```
